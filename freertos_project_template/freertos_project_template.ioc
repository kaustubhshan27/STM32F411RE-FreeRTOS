# file: freertos_project_template.ioc
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Mcu.Family=STM32F4
RCC.VCOOutputFreq_Value=200000000
RCC.APB2Freq_Value=100000000
RCC.CortexFreq_Value=100000000
NVIC.TIM2_IRQn=true\:0\:0\:false\:false\:true\:false\:true
Mcu.Name=STM32F411R(C-E)Tx
RCC.APB1CLKDivider=RCC_HCLK_DIV2
RCC.48MHZClocksFreq_Value=50000000
RCC.SYSCLKFreq_VALUE=100000000
Mcu.Package=LQFP64
VP_SYS_VS_tim2.Mode=TIM2
RCC.SYSCLKSource=RCC_SYSCLKSOURCE_PLLCLK
ProjectManager.StackSize=0x400
NVIC.TimeBase=TIM2_IRQn
NVIC.TimeBaseIP=TIM2
ProjectManager.HeapSize=0x200
ProjectManager.TargetToolchain=STM32CubeIDE
RCC.HSI_VALUE=16000000
NVIC.PriorityGroup=NVIC_PRIORITYGROUP_4
RCC.PLLM=8
RCC.HCLKFreq_Value=100000000
RCC.PLLN=100
RCC.APB2TimFreq_Value=100000000
RCC.APB1TimFreq_Value=100000000
RCC.APB1Freq_Value=50000000
RCC.LSE_VALUE=32768
RCC.AHBFreq_Value=100000000
RCC.HSE_VALUE=25000000
board=custom

// file: Core/Src/main.c
/* USER CODE BEGIN Header */
/**
  ******************************************************************************
  * @file           : main.c
  * @brief          : Main program body
  ******************************************************************************
  * @attention
  *
  * <h2><center>&copy; Copyright (c) 2021 STMicroelectronics.
  * All rights reserved.</center></h2>
  *
  * This software component is licensed by ST under BSD 3-Clause license,
  * the "License"; You may not use this file except in compliance with the
  * License. You may obtain a copy of the License at:
  *                        opensource.org/licenses/BSD-3-Clause
  *
  ******************************************************************************
  */
/* USER CODE END Header */
#include "main.h"

/* USER CODE BEGIN Includes */
#include <stdio.h>
#include <stdint.h>
#include <string.h>
#include "FreeRTOS.h"
#include "task.h"
/* USER CODE END Includes */

/* USER CODE BEGIN PM */
#define AVAILABLE 	1
#define UNAVAILABLE 0
/* USER CODE END PM */

void SystemClock_Config(void);
/* USER CODE BEGIN PFP */
void vTask1_handler(void*);
void vTask2_handler(void*);
void printmsg(const char*);
/* USER CODE END PFP */

/* USER CODE BEGIN 0 */
TaskHandle_t xTaskHandle1 = NULL;
TaskHandle_t xTaskHandle2 = NULL;
volatile uint8_t uart_access_key = AVAILABLE;
/* USER CODE END 0 */

int main(void)
{

  /* MCU Configuration--------------------------------------------------------*/

  /* Reset of all peripherals, Initializes the Flash interface and the Systick. */
  HAL_Init();

  /* Configure the system clock */
  SystemClock_Config();

  /* USER CODE BEGIN SysInit */

  //Enable CYCCNT for SEGGER SystemView
  DWT->CTRL |= (DWT_CTRL_CYCCNTENA_Msk);

  //Start SystemView Recording
  SEGGER_UART_init(9600);
  SEGGER_SYSVIEW_Conf();
  //SEGGER_SYSVIEW_Start(); //not required when recording using UART

  /* USER CODE END SysInit */

  /* Initialize all configured peripherals */
  /* USER CODE BEGIN 2 */
  xTaskCreate(vTask1_handler, "Task-1", configMINIMAL_STACK_SIZE, NULL, 2,
  			&xTaskHandle1);
  xTaskCreate(vTask2_handler, "Task-2", configMINIMAL_STACK_SIZE, NULL, 2,
  			&xTaskHandle2);

  char msg[50];
  sprintf(msg, "This is Hello World example code:\r\n");
  //printmsg(msg);
  SEGGER_SYSVIEW_PrintfTarget(msg);

  vTaskStartScheduler();
  /* USER CODE END 2 */

  /* Infinite loop */
  while (1)
  {

  }
}

void SystemClock_Config(void)
{
  RCC_OscInitTypeDef RCC_OscInitStruct = {0};
  RCC_ClkInitTypeDef RCC_ClkInitStruct = {0};

  /** Configure the main internal regulator output voltage
  */
  __HAL_RCC_PWR_CLK_ENABLE();
  __HAL_PWR_VOLTAGESCALING_CONFIG(PWR_REGULATOR_VOLTAGE_SCALE1);
  /** Initializes the RCC Oscillators according to the specified parameters
  * in the RCC_OscInitTypeDef structure.
  */
  RCC_OscInitStruct.OscillatorType = RCC_OSCILLATORTYPE_HSI;
  RCC_OscInitStruct.HSIState = RCC_HSI_ON;
  RCC_OscInitStruct.HSICalibrationValue = RCC_HSICALIBRATION_DEFAULT;
  RCC_OscInitStruct.PLL.PLLState = RCC_PLL_ON;
  RCC_OscInitStruct.PLL.PLLSource = RCC_PLLSOURCE_HSI;
  RCC_OscInitStruct.PLL.PLLM = 8;
  RCC_OscInitStruct.PLL.PLLN = 100;
  RCC_OscInitStruct.PLL.PLLP = RCC_PLLP_DIV2;
  RCC_OscInitStruct.PLL.PLLQ = 4;
  if (HAL_RCC_OscConfig(&RCC_OscInitStruct) != HAL_OK)
  {
    Error_Handler();
  }
  /** Initializes the CPU, AHB and APB buses clocks
  */
  RCC_ClkInitStruct.ClockType = RCC_CLOCKTYPE_HCLK|RCC_CLOCKTYPE_SYSCLK
                              |RCC_CLOCKTYPE_PCLK1|RCC_CLOCKTYPE_PCLK2;
  RCC_ClkInitStruct.SYSCLKSource = RCC_SYSCLKSOURCE_PLLCLK;
  RCC_ClkInitStruct.AHBCLKDivider = RCC_SYSCLK_DIV1;
  RCC_ClkInitStruct.APB1CLKDivider = RCC_HCLK_DIV2;
  RCC_ClkInitStruct.APB2CLKDivider = RCC_HCLK_DIV1;

  if (HAL_RCC_ClockConfig(&RCC_ClkInitStruct, FLASH_LATENCY_3) != HAL_OK)
  {
    Error_Handler();
  }
}

/* USER CODE BEGIN 4 */

//had to introduce a key to prevent preemption of the task before it finishes sending data via UART
void vTask1_handler(void *params) {
	char msg[50] = "Hello-World from T1\r\n";
	while (1) {
		if (uart_access_key == AVAILABLE) {
			uart_access_key = UNAVAILABLE;
			SEGGER_SYSVIEW_PrintfTarget(msg);
			//printmsg("Hello-World from T1\r\n");
			uart_access_key = AVAILABLE;
			taskYIELD(); //after UART is done, manually trigger context switch to the other task
		}
	}
}

//had to introduce a key to prevent preemption of the task before it finishes sending data via UART
void vTask2_handler(void *params) {
	char msg[50] = "Hello-World from T2\r\n";
	while (1) {
		if (uart_access_key == AVAILABLE) {
			uart_access_key = UNAVAILABLE;
			SEGGER_SYSVIEW_PrintfTarget(msg);
			//printmsg("Hello-World from T2\r\n");
			uart_access_key = AVAILABLE;
			taskYIELD(); //after UART is done, manually trigger context switch to the other task
		}
	}
}
/* USER CODE END 4 */

 /**
  * @brief  Period elapsed callback in non blocking mode
  * @note   This function is called  when TIM2 interrupt took place, inside
  * HAL_TIM_IRQHandler(). It makes a direct call to HAL_IncTick() to increment
  * a global variable "uwTick" used as application time base.
  * @param  htim : TIM handle
  * @retval None
  */
void HAL_TIM_PeriodElapsedCallback(TIM_HandleTypeDef *htim)
{
  if (htim->Instance == TIM2) {
    HAL_IncTick();
  }
}

void Error_Handler(void)
{
  __disable_irq();
  while (1)
  {
  }
}

/************************ (C) COPYRIGHT STMicroelectronics *****END OF FILE****/
